## components/mybot/mybot_sdk/Kconfig
```kconfig
menu "MyBot BK7259 platform"

    config MYBOT_HTTPS
        bool "Use HTTPS for the device service"
        default y
        help
            Use HTTPS for the language-selected device-service endpoint.
            Disable this option to use HTTP with the same host and API path.
            This selects both the URL scheme and the SDK transport flags;
            RTC and RTM transport are unchanged.

    config MYBOT_LVGL_UI_ANIMATIONS
        bool "Animate pixel glasses and terminal cursor"
        default y
        depends on LVGL && LVGL_V9
        help
            Fade between pixel-glasses expressions in 250 ms, update expression
            motion at up to 20 fps, and blink the terminal cursor every 500 ms.
            The fixed process-gray theme runs in the existing product-owned
            UI thread. Disabling this keeps all 23 expressions static.

    config MYBOT_GIMBAL
        bool "Enable EB521 gimbal control"
        default y
        depends on UART && USR_GPIO_CFG_EN
        select UART2
        help
            Enable EB521 control and manual gimbal_cmd/gimbal_scene commands
            using the R2 board's UART2 connection (GPIO2 TX, GPIO3 RX, 115200
            baud, 8N1). Motion commands are serialized and manual scenes return
            to center when complete. Local LCD expressions do not move the gimbal.

    config MYBOT_VIDEO
        bool "Enable MyBot encoded video uplink"
        default n
        depends on ISP && MIPI_CSI && CSI_CAMERA && (CSI_GC2053 || CSI_CV2005) && BK_ENCODER
        depends on MULTIMEDIA_DEVICE_SERVICE && MULTIMEDIA_H264_ENCODE
        help
            Capture the BK7259 MIPI CSI camera and upload complete H.264
            access units through the MyBot RTC session.

    config MYBOT_VIDEO_WIDTH
        int "MyBot video width"
        range 16 1280
        default 640
        depends on MYBOT_VIDEO

    config MYBOT_VIDEO_HEIGHT
        int "MyBot video height"
        range 16 720
        default 480
        depends on MYBOT_VIDEO

    config MYBOT_VIDEO_SENSOR_WIDTH
        int "MyBot MIPI sensor width"
        range 16 2000
        default 1280
        depends on MYBOT_VIDEO

    config MYBOT_VIDEO_SENSOR_HEIGHT
        int "MyBot MIPI sensor height"
        range 16 1200
        default 720
        depends on MYBOT_VIDEO

    config MYBOT_VIDEO_SENSOR_FPS
        int "MyBot MIPI sensor frame rate"
        range 1 60
        default 5
        depends on MYBOT_VIDEO

    config MYBOT_VIDEO_MIN_BPS
        int "MyBot minimum video bitrate"
        range 1 10000000
        default 256000
        depends on MYBOT_VIDEO

    config MYBOT_VIDEO_MAX_BPS
        int "MyBot maximum video bitrate"
        range 1 10000000
        default 512000
        depends on MYBOT_VIDEO

    choice MYBOT_LANGUAGE
        prompt "MyBot device language"
        default MYBOT_LANGUAGE_ZH_CN
        help
            Select the language used by the device service, LCD and local
            voice prompts. The endpoint and embedded prompt tag follow this
            choice.

        config MYBOT_LANGUAGE_ZH_CN
            bool "Chinese"

        config MYBOT_LANGUAGE_EN_US
            bool "English"
    endchoice

    # The R2 product has one firmware-visible direct GPIO key. Keep a single
    # active level and emit only a short-press conversation event.
    config MYBOT_KEY_GPIO
        int "MyBot conversation key GPIO"
        range 0 71
        default 47
        help
            GPIO connected to the single conversation key. The Yunqu V1.0
            schematic connects KEY1 to BK7259 GPIO47 with an internal pull-up.

    config MYBOT_KEY_ACTIVE_LEVEL
        int "MyBot conversation key active level"
        range 0 1
        default 0
        help
            Electrical level while the key is pressed. The R2 key is active low.

endmenu
```
